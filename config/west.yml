## config/west.yml
```yaml
manifest:
  remotes:
    - name: zmkfirmware
      url-base: https://github.com/zmkfirmware
    - name: m165437 #new entry
      url-base: https://github.com/M165437 #new entry
    - name: devcharmander                         #new entry
      url-base: https://github.com/devcharmander  #new entry
  projects:
    - name: zmk
      remote: zmkfirmware
      revision: main
      import: app/west.yml
    - name: nice-view-gem #new entry
      remote: m165437 #new entry
      revision: main #new entry
    - name: corne-peripheral-animation   #new entry
      remote: devcharmander                       #new entry
      revision: main                      #new entry
  self:
    path: config
```
